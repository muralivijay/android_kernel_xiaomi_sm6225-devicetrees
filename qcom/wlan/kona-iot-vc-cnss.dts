/dts-v1/;
/plugin/;

#include "kona-iot-vc-cnss.dtsi"

/ {
	model = "Qualcomm Technologies, Inc. kona-iot VC";
	compatible = "qcom,kona-iot";
	qcom,board-id = <0x010020 0x07>;
	qcom,msm-id = <0x1e1 0x20001>;
};
