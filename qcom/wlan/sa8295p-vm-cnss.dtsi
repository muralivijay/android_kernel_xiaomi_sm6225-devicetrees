&soc {
	wlan: qcom,cnss-qca-converged {
		compatible = "qcom,cnss-qca-converged";
		qcom,wlan;
		qcom,multi-wlan-exchg;
		qcom,wlan-rc-num = <4>;
		qcom,bus-type=<0>;
		qcom,notify-modem-status;
		qcom,wlan-cbc-enabled;

		reg = <0xb0000000 0x10000>;
		reg-names = "smmu_iova_ipa";

		vdd-wlan-ctrl1-supply = <&vreg_conn_pa>;
		vdd-wlan-ctrl2-supply = <&vreg_conn_1p8>;
		vdd-wlan-supply = <&vreg_wlan>;
		vdd-wlan-aon-supply = <&pm8540_e0_s4>;
		vdd-wlan-rfa1-supply = <&pm8540_g0_l6>;
		vdd-wlan-rfa3-supply = <&pm8540_a0_l15>;

		wlan_vregs = "vdd-wlan-ctrl1", "vdd-wlan-ctrl2", "vdd-wlan-aon",
			     "vdd-wlan-rfa1", "vdd-wlan-rfa3";
		qcom,vdd-wlan-ctrl1-config = <0 0 0 0 0>;
		qcom,vdd-wlan-ctrl2-config = <0 0 0 0 0>;
		/* no vote-off as sw_ctrl is not supported */
		qcom,vdd-wlan-aon-config = <1055000 1055000 0 0 0>;
		/* No vol setting for bypass LDOs */
		qcom,vdd-wlan-rfa1-config = <0 0 0 0 0>;
		qcom,vdd-wlan-rfa3-config = <0 0 0 0 0>;
		wlan-en-gpio = <&tlmm 125 0>;
		pinctrl-names = "wlan_en_active", "wlan_en_sleep", "default";
		pinctrl-0 = <&cnss_wlan_en_active>;
		pinctrl-1 = <&cnss_wlan_en_sleep>;
		pinctrl-2 = <&cnss_wlan_en_sleep>;

		chip_cfg@0 {
			supported-ids = <0x1101>;
			qcom,wlan-ramdump-dynamic = <0x400000>;
		};

		chip_cfg@1 {
			supported-ids = <0x1103>;
			qcom,wlan-ramdump-dynamic = <0x400000>;
		};
	};
};
